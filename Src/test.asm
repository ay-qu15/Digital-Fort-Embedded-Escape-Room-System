__CONFIG _DEBUG_OFF&_CP_OFF&_WRT_HALF&_CPD_OFF&_LVP_OFF&_BODEN_OFF&_PWRTE_OFF&_WDT_OFF&_XT_OSC
;******************************************************************************************************
	include "p16f877A.inc"
;******************************************************************************************************
; User-defined variables
	cblock	0x20
		msd
		lsd
		FLAG
		COUNTER
		RV
		DEFINED_VALUE ;;;ADDED WED 8:24PM	
		temp
		temp2
		ADC_OUTPUT	
		ANSWER
		DCounter1
		DCounter2
		DCounter3
		ANSWER1
		FLAG3
		endc
	ORG 0X00
		GOTO MAIN
	ORG 0X04
		GOTO ISR

MAIN
	CALL INITIAL
CHALLENGE1
	BTFSC FLAG3,1
	CALL HARD_LUCK
	CLRF FLAG3
	Movlw	0x02		;Display and cursor home
	Call	SEND_CMD
	Movlw	0x01		;clear display
	Call	SEND_CMD
	BANKSEL PORTC
	MOVLW B'11000000' ; DISPLAY 0
	MOVWF PORTC    
	CALL DELAY_5S
	BTFSC PORTB,RB4   ; CHECKING INPUT IF CHANGE 
	GOTO START_1
	BTFSC PORTB,RB5   ; CHECKING INPUT IF CHANGE
	GOTO START_1
	BTFSC PORTB,RB6   ; CHECKING INPUT IF CHANGE
	GOTO START_1
	BTFSC PORTB,RB7   ; CHECKING INPUT IF CHANGE
	GOTO START_1
	GOTO CHALLENGE1

START_1  ;;;;;;;;;;;CHECK IF PRIME (3,5,7,11,13)
;	CALL DELAY_10S ;;;;;;THIS DELAY IS TO WAIT UNTIL USER INPUTS ALL 4 BITS
	MOVF PORTB,W
    MOVWF ANSWER1
    MOVLW b'11110000'
    ANDWF ANSWER1,F
    SWAPF ANSWER1,F
	MOVLW D'3'
	SUBWF ANSWER1, W  
	BTFSC STATUS , Z
	GOTO PASS_1
	MOVLW D'5'
	SUBWF ANSWER1 , W
	BTFSC STATUS , Z
	GOTO PASS_1
	MOVLW D'7'
	SUBWF ANSWER1 , W
	BTFSC STATUS , Z
	GOTO PASS_1
	MOVLW D'11'
	SUBWF ANSWER1 , W
	BTFSC STATUS , Z
	GOTO PASS_1
	MOVLW D'13'
	SUBWF ANSWER1 , W
	BTFSC STATUS , Z
	GOTO PASS_1

DISPLAY_NOT_PRIME
	BANKSEL PORTC
	MOVLW B'00110110'
	MOVWF PORTC
	CALL HARD_LUCK
;	CALL DELAY ;2SECONDS DELAY MADE INTO 10S
	GOTO START_1
PASS_1
	BANKSEL PORTC
	MOVLW B'00001100'
	MOVWF PORTC
	BSF PORTE,RE2 ;LIGHT CORR1 LED
	CALL DELAY
	BCF PORTE,RE2
	MOVLW D'255'					
	MOVWF PORTC
CHALLENGE2
;	BSF PORTE,RE1
	CALL DELAY   ;;TO GIVE PLAYER TIME TO ROTATE THE KNOB
	BCF PORTE,RE1
	BANKSEL ADCON0
	BSF ADCON0, ADON ;;START TAKING SAMPLES
	CALL DELAY_ACQ      ;;WAIT TO ACQUIRE A SAMPLE
	
	BSF ADCON0, GO ;START THE CONVERSION NOW
	CALL DELAY     ;WHEN CONVERSION IS DONE THERE WILL BE AN INTERRUPT
				   ;IN THE INTERRUPT THE CONVERTED VALUE WILL BE SAVED
;	BSF PORTE,RE1			   
	MOVLW D'51'
	SUBWF ADC_OUTPUT, W
	BTFSS STATUS, C
	GOTO CHALLENGE2   ;;AND NOTHING IS PRINTED ON LCD
;	BSF PORTE,RE1
	BCF STATUS,C
	MOVLW D'102'
	SUBWF ADC_OUTPUT, W
	BTFSS STATUS,C
	GOTO YOU_ARE_SO_CLOSE
	BCF STATUS,C
	MOVLW D'153'
	SUBWF ADC_OUTPUT, W
	BTFSS STATUS,C
	GOTO YOU_ARE_CORRECT
	MOVLW D'204'
	SUBWF ADC_OUTPUT,W
	BTFSS STATUS,C
	GOTO YOU_ARE_SO_CLOSE
	GOTO CHALLENGE2 ;;AND NOTHING IS PRINTED ON LCD
	
	
	
CHALLENGE3
	MOVLW D'255'
	MOVWF FLAG3
	BTFSS PORTB,0
	GOTO START_3
	GOTO CHALLENGE3
START_3
	GOTO RANDOM_CHALLENGE
		
ISR	
	movwf temp ;context saving
	swapf STATUS,W
	MOVWF temp2
	
	BANKSEL PIR1
	BCF PIR1,ADIF
	MOVF ADRESH,W
	MOVWF ADC_OUTPUT
;	BSF PORTE,RE2
	SWAPF temp2,W ;;context retrieval
	MOVWF STATUS
	MOVF temp,W	
	RETFIE
LOOKUP_CHALLENGE3
    ADDWF PCL,F
    NOP
    RETLW 0XF9
    RETLW 0XA4
    RETLW 0XB0
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    RETLW 0x98
    RETURN		
	
INITIAL
	BANKSEL PORTA
	CLRF PORTA
	CLRF PORTB
	CLRF PORTC
	CLRF PORTD
	CLRF PORTE 
	BANKSEL PIR1
	BCF PIR1, ADIF ;;;ADDED ON WEDENSDAY
	
	BANKSEL TRISD
	CLRF COUNTER
	CLRF TRISD
	CLRF TRISC
	MOVLW D'255'
	MOVWF TRISB
	CLRF TRISE
;	MOVLW D'128'
;	MOVWF DEFINED_VALUE ;;128 *4 = 512 CORRESPONDS TO 2.5 INPUT VOLTAGE
						;;FROM THE POTENTIOMETER WHICH IS IN R3
						;;*4 COMES FROM ME USING ADRESH AS 8 BITS ONLY AND 
						;;IGNORING ADRESL WHEN THE ADC IS CONVERTING TO 10-BITS
	MOVLW B'00000001'
	MOVWF TRISA
	MOVLW B'00001110'
	MOVWF ADCON1
	BSF PIE1, ADIE     ;;ADDED ON WEDNESDAY
	
	BANKSEL ADCON0
	MOVLW B'01000000' ;;CHANGED ADON EG BIT0 TO ZERO, NO NEED TO TAKE SAMPLES HERE
	MOVWF ADCON0
	
	Movlw	0x38		;8-bit mode, 2-line display, 5x7 dot format
	Call	SEND_CMD	
	Movlw	0x0e		;Display on, Cursor Underline on, Blink off
	Call	SEND_CMD
	Movlw	0x02		;Display and cursor home
	Call	SEND_CMD
	Movlw	0x01		;clear display
	Call	SEND_CMD
	
	BSF INTCON,GIE
	BSF INTCON,PEIE
	RETURN	
	

SEND_CHAR
	movwf PORTD; Refer to table 1 on Page 5 for review of this subroutine
	bsf PORTA, 1	
	bsf PORTA, 3
	nop
	bcf PORTA, 3
	bcf PORTA, 2
	call DELAY_LCD
	return

SEND_CMD
	movwf PORTD; Refer to table 1 on Page 5 for review of this subroutine
	bcf	PORTA, 1
	bsf	PORTA, 3
	nop
	bcf PORTA, 3
	bcf PORTA, 2
	call DELAY_LCD
	return		

DELAY_LCD
	movlw 0x80
	movwf msd
	clrf lsd
loop2
	decfsz lsd,f
	goto loop2
	decfsz msd,f
endLcd
	goto loop2
	return
	
YOU_ARE_CORRECT ;;;;;FOR THE 1ST CHALLENGE
	MOVLW 0X59
	CALL SEND_CHAR
	MOVLW 0X6F
	CALL SEND_CHAR
	MOVLW 0X75
	CALL SEND_CHAR
	MOVLW 0X20    ;;;;;;;;SPACE CHARACTER
	CALL SEND_CHAR
	MOVLW 0X41
	CALL SEND_CHAR
	MOVLW 0X72
	CALL SEND_CHAR
	MOVLW 0X65
	CALL SEND_CHAR
	MOVLW 0X20
	CALL SEND_CHAR
	MOVLW 0X43
	CALL SEND_CHAR
	MOVLW 0X6F
	CALL SEND_CHAR
	MOVLW 0X72
	CALL SEND_CHAR
	MOVLW 0X72
	CALL SEND_CHAR
	MOVLW 0X65
	CALL SEND_CHAR
	MOVLW 0X63
	CALL SEND_CHAR
	MOVLW 0X74
	CALL SEND_CHAR
	MOVLW 0X21      ;;;;;THIS IS FOR ( ! )
	CALL SEND_CHAR
	
	Movlw	0x02		;Display and cursor home
	Call	SEND_CMD
	Movlw	0x01		;clear display
	Call	SEND_CMD
	
	BANKSEL PORTC
	MOVLW D'255' 
	MOVWF PORTC
	BSF PORTE,1 ;;RE1
	CALL DELAY
	BCF PORTE,1
	GOTO CHALLENGE3

YOU_ARE_SO_CLOSE
	MOVLW A'Y'	
	CALL SEND_CHAR
	MOVLW A'o'	
	CALL SEND_CHAR
	MOVLW A'u'	
	CALL SEND_CHAR
	MOVLW A' '	
	CALL SEND_CHAR
	MOVLW A'A'	
	CALL SEND_CHAR
	MOVLW A'r'	
	CALL SEND_CHAR
	MOVLW A'e'	
	CALL SEND_CHAR
	MOVLW A' '	
	CALL SEND_CHAR
	MOVLW A'S'	
	CALL SEND_CHAR
	MOVLW A'o'	
	CALL SEND_CHAR
	MOVLW A' '	
	CALL SEND_CHAR
	MOVLW A'C'	
	CALL SEND_CHAR
	MOVLW A'l'	
	CALL SEND_CHAR
	MOVLW A'o'	
	CALL SEND_CHAR
	MOVLW A's'	
	CALL SEND_CHAR
	MOVLW A'e'	
	CALL SEND_CHAR
	
	Movlw	0x02		;Display and cursor home
	Call	SEND_CMD
	Movlw	0x01		;clear display
	Call	SEND_CMD	
	
	GOTO CHALLENGE2     ;;TO REPEAT CHALLENGE2 ONLY
	
YOU_WIN_ESCAPE
	MOVLW A'Y'	
	CALL SEND_CHAR
	MOVLW A'o'	
	CALL SEND_CHAR
	MOVLW A'u'	
	CALL SEND_CHAR
	MOVLW A' '	
	CALL SEND_CHAR
	MOVLW A'W'	
	CALL SEND_CHAR
	MOVLW A'i'	
	CALL SEND_CHAR
	MOVLW A'n'	
	CALL SEND_CHAR
	MOVLW A'!'	
	CALL SEND_CHAR
	MOVLW A' '	
	CALL SEND_CHAR
	MOVLW A'E'	
	CALL SEND_CHAR
	MOVLW A's'	
	CALL SEND_CHAR
	MOVLW A'c'	
	CALL SEND_CHAR
	MOVLW A'a'	
	CALL SEND_CHAR
	MOVLW A'p'	
	CALL SEND_CHAR
	MOVLW A'e'	
	CALL SEND_CHAR
	
	Movlw	0x02		;Display and cursor home
	Call	SEND_CMD
	Movlw	0x01		;clear display
	Call	SEND_CMD
	
	BANKSEL PORTC
	MOVLW D'255'
	MOVWF PORTC

	BSF PORTE,0
	BSF PORTE,1
	BSF PORTE,2
	CALL DELAY
	BCF PORTE,RE0
	BCF PORTE,RE1
	BCF PORTE,RE2
	CALL DELAY
	BSF PORTE,0
	BSF PORTE,1
	BSF PORTE,2
	CALL DELAY
	BCF PORTE,RE0
	BCF PORTE,RE1
	BCF PORTE,RE2

	CLRF FLAG3	
	RETURN
	
RANDOM_CHALLENGE ;FIVE PROBLEMS: ADD,SUBTRACT,SHIFT LEFT,SHIFT RIGHT,MOD%
	BANKSEL ADC_OUTPUT
REPEAT	
	MOVLW D'5' 
	SUBWF ADC_OUTPUT,F
	BTFSC STATUS,C
	GOTO REPEAT
	MOVLW D'5'
	ADDWF ADC_OUTPUT,F ;NOW ADC_OUTPUT HAS THE MOD VALUE AS IN WHICH CHALLENGE TO TAKE
	CLRF W
	SUBWF ADC_OUTPUT,W
	BTFSC STATUS,Z
	GOTO Q0
	MOVLW D'1'
	SUBWF ADC_OUTPUT,W
	BTFSC STATUS,Z
	GOTO Q1
	MOVLW D'2'
	SUBWF ADC_OUTPUT,W
	BTFSC STATUS,Z
	GOTO Q2
	MOVLW D'3'
	SUBWF ADC_OUTPUT,W
	BTFSC STATUS,Z
	GOTO Q3
	MOVLW D'4'
	SUBWF ADC_OUTPUT,W
	BTFSC STATUS,Z
	GOTO Q4	
;	GOTO CHALLENGE1		
Q0
	CALL QUESTION0_LCD_ADDITION
	CALL WAITING_9SECONDS_TOANSWER
		Movlw	0x02		;Display and cursor home
	Call	SEND_CMD
	Movlw	0x01		;clear display
	Call	SEND_CMD
	MOVLW D'255'
	SUBWF FLAG,W
	BTFSC STATUS,Z
;	GOTO  CHALLENGE1
	MOVLW b'11110000'
	ANDWF PORTB,F
	SWAPF PORTB,W
	MOVWF ANSWER
	MOVLW D'2'
	SUBWF ANSWER,W
	BTFSC STATUS,Z
	CALL YOU_WIN_ESCAPE
	GOTO CHALLENGE1
Q1
	CALL QUESTION1_LCD_SUBTRACTION
	CALL WAITING_9SECONDS_TOANSWER
		Movlw	0x02		;Display and cursor home
	Call	SEND_CMD
	Movlw	0x01		;clear display
	Call	SEND_CMD
	MOVLW D'255'
	SUBWF FLAG,W
	BTFSC STATUS,Z
;	GOTO  CHALLENGE1
	MOVLW b'11110000'
	ANDWF PORTB,F
	SWAPF PORTB,W
	MOVWF ANSWER
	MOVLW D'1'
	SUBWF ANSWER,W
	BTFSC STATUS,Z
	CALL YOU_WIN_ESCAPE
	GOTO CHALLENGE1
Q2
	CALL QUESTION2_LCD_MUL
	CALL WAITING_9SECONDS_TOANSWER
	Movlw	0x02		;Display and cursor home
	Call	SEND_CMD
	Movlw	0x01		;clear display
	Call	SEND_CMD
	MOVLW D'255'
	SUBWF FLAG,W
	BTFSC STATUS,Z
;	GOTO  CHALLENGE1
	MOVLW b'11110000'
	ANDWF PORTB,F
	SWAPF PORTB,W
	MOVWF ANSWER
	MOVLW D'4'
	SUBWF ANSWER,W
	BTFSC STATUS,Z
	CALL YOU_WIN_ESCAPE
	GOTO CHALLENGE1
Q3
	CALL QUESTION3_LCD_DIV
	CALL WAITING_9SECONDS_TOANSWER
	Movlw	0x02		;Display and cursor home
	Call	SEND_CMD
	Movlw	0x01		;clear display
	Call	SEND_CMD
	MOVLW D'255'
	SUBWF FLAG,W
	BTFSC STATUS,Z
;	GOTO  CHALLENGE1
	MOVLW b'11110000'
	ANDWF PORTB,F
	SWAPF PORTB,W
	MOVWF ANSWER
	MOVLW D'1'
	SUBWF ANSWER,W
	BTFSC STATUS,Z
	CALL YOU_WIN_ESCAPE
	GOTO CHALLENGE1
	
Q4
	CALL QUESTION4_LCD_MOD
	CALL WAITING_9SECONDS_TOANSWER
		Movlw	0x02		;Display and cursor home
	Call	SEND_CMD
	Movlw	0x01		;clear display
	Call	SEND_CMD
	MOVLW D'255'
	SUBWF FLAG,W
	BTFSC STATUS,Z
;	GOTO  CHALLENGE1
	MOVLW b'11110000'
	ANDWF PORTB,F
	SWAPF PORTB,W
	MOVWF ANSWER
	MOVLW D'2'
	SUBWF ANSWER,W
	BTFSC STATUS,Z
	CALL YOU_WIN_ESCAPE
	GOTO CHALLENGE1

QUESTION0_LCD_ADDITION
	MOVLW A'1'
	CALL SEND_CHAR
	MOVLW A' '
	CALL SEND_CHAR
	MOVLW A'+'
	CALL SEND_CHAR
	MOVLW A' '
	CALL SEND_CHAR
	MOVLW A'1'
	CALL SEND_CHAR
	MOVLW A' '
	CALL SEND_CHAR
	MOVLW A'='
	CALL SEND_CHAR	
	RETURN
	
QUESTION1_LCD_SUBTRACTION
	MOVLW A'2'
	CALL SEND_CHAR
	MOVLW A' '
	CALL SEND_CHAR
	MOVLW A'-'
	CALL SEND_CHAR
	MOVLW A' '
	CALL SEND_CHAR
	MOVLW A'1'
	CALL SEND_CHAR
	MOVLW A' '
	CALL SEND_CHAR
	MOVLW A'='
	CALL SEND_CHAR	
	RETURN

QUESTION2_LCD_MUL
	MOVLW A'2'
	CALL SEND_CHAR
	MOVLW A' '
	CALL SEND_CHAR
	MOVLW A'*'
	CALL SEND_CHAR
	MOVLW A' '
	CALL SEND_CHAR
	MOVLW A'2'
	CALL SEND_CHAR
	MOVLW A' '
	CALL SEND_CHAR
	MOVLW A'='
	CALL SEND_CHAR	
	RETURN

QUESTION3_LCD_DIV
	MOVLW A'5'
	CALL SEND_CHAR
	MOVLW A' '
	CALL SEND_CHAR
	MOVLW A'/'
	CALL SEND_CHAR
	MOVLW A' '
	CALL SEND_CHAR
	MOVLW A'5'
	CALL SEND_CHAR
	MOVLW A' '
	CALL SEND_CHAR
	MOVLW A'='
	CALL SEND_CHAR	
	RETURN

QUESTION4_LCD_MOD
	MOVLW A'5'
	CALL SEND_CHAR
	MOVLW A' '
	CALL SEND_CHAR
	MOVLW A'M'
	CALL SEND_CHAR
	MOVLW A'o'
	CALL SEND_CHAR
	MOVLW A'd'
	CALL SEND_CHAR
	MOVLW A' '
	CALL SEND_CHAR
	MOVLW A'3'
	CALL SEND_CHAR
	MOVLW A' '
	CALL SEND_CHAR
	MOVLW A'='
	CALL SEND_CHAR	
	RETURN
	
	BANKSEL PORTC
	MOVLW D'9'
	MOVWF COUNTER
	BTFSC PORTB,1
	

	
WAITING_9SECONDS_TOANSWER
	BANKSEL PORTC
	MOVLW D'9'
	
	MOVWF COUNTER     ;;;;;;9
	CALL LOOKUP_CHALLENGE3
	MOVWF PORTC
	CALL DELAY_ONE_SECOND
	BTFSS PORTB,1
	RETURN
	
	MOVF COUNTER,W   ;;;;;;;8
	CALL LOOKUP_CHALLENGE3
	MOVWF PORTC
	CALL DELAY_ONE_SECOND
	BTFSS PORTB,1
	RETURN
	
	MOVF COUNTER,W ;;;;;;;;;7
	CALL LOOKUP_CHALLENGE3
	MOVWF PORTC
	CALL DELAY_ONE_SECOND
	BTFSS PORTB,1
	RETURN
	
	MOVF COUNTER,W;;;;;;;;;;6
	CALL LOOKUP_CHALLENGE3
	MOVWF PORTC
	CALL DELAY_ONE_SECOND
	BTFSS PORTB,1
	RETURN
	
	MOVF COUNTER,W ;;;;;;;;;5
	CALL LOOKUP_CHALLENGE3
	MOVWF PORTC
	CALL DELAY_ONE_SECOND
	BTFSS PORTB,1
	RETURN
	
	MOVF COUNTER,W ;;;;;;;;;4
	CALL LOOKUP_CHALLENGE3
	MOVWF PORTC
	CALL DELAY_ONE_SECOND
	BTFSS PORTB,1
	RETURN
	
	MOVF COUNTER,W ;;;;;;;;;3
	CALL LOOKUP_CHALLENGE3
	MOVWF PORTC
	CALL DELAY_ONE_SECOND
	BTFSS PORTB,1
	RETURN
	
	MOVF COUNTER,W ;;;;;;;;;2
	CALL LOOKUP_CHALLENGE3
	MOVWF PORTC
	CALL DELAY_ONE_SECOND
	BTFSS PORTB,1
	RETURN
	
	MOVF COUNTER,W ;;;;;;;;;1
	CALL LOOKUP_CHALLENGE3
	MOVWF PORTC
	CALL DELAY_ONE_SECOND
	BTFSS PORTB,1
	RETURN	
	
	
	
	MOVLW D'255'
	MOVWF FLAG
			
	RETURN	;	GOTO CHALLENGE1 ;THIS WILL BE EXECUTED IF TIME REACHES 0 AND THE
			; USER HAS NOT ANSWERED
			
			
DELAY_ACQ  ;;0.5 SECOND,,,,500 MILLISECONDS
	MOVLW 0X54
	MOVWF DCounter1
	MOVLW 0X8a
	MOVWF DCounter2
	MOVLW 0X03
	MOVWF DCounter3
LOOP_ACQ
	DECFSZ DCounter1, 1
	GOTO LOOP_ACQ
	DECFSZ DCounter2, 1
	GOTO LOOP_ACQ
	DECFSZ DCounter3, 1
	GOTO LOOP_ACQ
	NOP
	RETURN
DELAY_10S
	MOVLW 0Xde
	MOVWF DCounter1
	MOVLW 0Xbb
	MOVWF DCounter2
	MOVLW 0X33
	MOVWF DCounter3
LOOP_10S
	DECFSZ DCounter1, 1
	GOTO LOOP_10S
	DECFSZ DCounter2, 1
	GOTO LOOP_10S
	DECFSZ DCounter3, 1
	GOTO LOOP_10S
	NOP
	RETURN
DELAY ;THIS DELAY IS 2SECONDS
	MOVLW 0X5c
	MOVWF DCounter1
	MOVLW 0X26
	MOVWF DCounter2
	MOVLW 0X0b
	MOVWF DCounter3
LOOP_2S
	DECFSZ DCounter1, 1
	GOTO LOOP_2S
	DECFSZ DCounter2, 1
	GOTO LOOP_2S
	DECFSZ DCounter3, 1
	GOTO LOOP_2S
	NOP
	RETURN
DELAY_ONE_SECOND
	MOVLW 0Xac
	MOVWF DCounter1
	MOVLW 0X13
	MOVWF DCounter2
	MOVLW 0X06
	MOVWF DCounter3
LOOP_1S
	DECFSZ DCounter1, 1
	GOTO LOOP_1S
	DECFSZ DCounter2, 1
	GOTO LOOP_1S
	DECFSZ DCounter3, 1
	GOTO LOOP_1S
	NOP
	DECF COUNTER,F
	RETURN
DELAY_5S
	MOVLW 0X6d
	MOVWF DCounter1
	MOVLW 0X5e
	MOVWF DCounter2
	MOVLW 0X1a
	MOVWF DCounter3
LOOP_5S
	DECFSZ DCounter1, 1
	GOTO LOOP_5S
	DECFSZ DCounter2, 1
	GOTO LOOP_5S
	DECFSZ DCounter3, 1
	GOTO LOOP_5S
	RETURN	

HARD_LUCK
	MOVLW A'H'
	CALL SEND_CHAR
	MOVLW A'A'
	CALL SEND_CHAR
	MOVLW A'R'
	CALL SEND_CHAR
	MOVLW A'D'
	CALL SEND_CHAR
	MOVLW A' '
	CALL SEND_CHAR
	MOVLW A'L'
	CALL SEND_CHAR
	MOVLW A'U'
	CALL SEND_CHAR
	MOVLW A'C'
	CALL SEND_CHAR
	MOVLW A'K'
	CALL SEND_CHAR	
	MOVLW A'!'
	CALL SEND_CHAR
	CALL DELAY
	
	Movlw	0x02		;Display and cursor home
	Call	SEND_CMD
	Movlw	0x01		;clear display
	Call	SEND_CMD
	
	RETURN
		
								
	END
